## src/main/CDH/boards/coral/coral_stm32/coral_stm32_defconfig
```kconfig
# --- CORE SUBSYSTEMS ---
CONFIG_GPIO=y
CONFIG_PINCTRL=y
CONFIG_CLOCK_CONTROL=y

# --- SERIAL & CONSOLE ---
CONFIG_SERIAL=y
CONFIG_CONSOLE=y
CONFIG_UART_CONSOLE=y
CONFIG_UART_INTERRUPT_DRIVEN=y
CONFIG_UART_LINE_CTRL=y

# --- USB VIRTUAL COM PORT (CDC ACM) ---
CONFIG_USB_DEVICE_STACK=y
CONFIG_USB_DEVICE_PRODUCT="Coral CDH Board"
CONFIG_USB_DEVICE_VID=0x1209
CONFIG_USB_DEVICE_PID=0x0001
CONFIG_USB_DEVICE_INITIALIZE_AT_BOOT=y

# (Optional but recommended) Wait for USB connection before booting main()
# This ensures you don't miss early printk() messages before opening Putty/Minicom
# CONFIG_USB_DEVICE_INITIALIZE_AT_BOOT is usually enough, but sometimes apps need a delay.
```

## src/main/CDH_image_demo/boards/coral/coral_stm32/coral_stm32_defconfig
```kconfig
# --- CORE HARDWARE ---

CONFIG_GPIO=y
CONFIG_PINCTRL=y
CONFIG_CLOCK_CONTROL=y

## Keeps the SWD debug pins alive even if the CPU idles

CONFIG_DEBUG=y

## Prevents power management from shutting down clocks while debugging

CONFIG_PM=n

## Prevents the hardware watchdog from infinite-looping an empty app

CONFIG_WATCHDOG=n

## --- BASE SERIAL & USB HARDWARE ---

CONFIG_SERIAL=y
CONFIG_CONSOLE=y
CONFIG_UART_CONSOLE=n
CONFIG_UART_LINE_CTRL=y
CONFIG_USB_DEVICE_STACK=y
CONFIG_USB_CDC_ACM=y

## --- STABILITY ---

CONFIG_ARM_MPU=y
CONFIG_HW_STACK_PROTECTION=y
```

## src/main/COM/boards/coral/coral_nrf52833/board.yml
```yaml
board:
  name: coral_nrf52833
  full_name: Coral nRF52833
  vendor: coral
  socs:
  - name: nrf52833
```

## west.yml
```yaml
manifest:
  remotes:
    - name: zephyrproject-rtos
      url-base: https://github.com/zephyrproject-rtos

  projects:
    - name: zephyr
      remote: zephyrproject-rtos
      revision: v4.2.0
      import:
        name-allowlist:
          - cmsis              # Core ARM Cortex headers (required by both)
          - hal_stm32          # Vendor HAL for the STM32
          - hal_nordic         # Vendor HAL for the nRF52833
          - segger             # Standard debug libs
  self:
    path: coral-cubed-flight
```
